## conf/layer.conf
```bitbake
# We have a conf and classes directory, add to BBPATH
BBPATH .= ":${LAYERDIR}"

# We have recipes-* directories, add to BBFILES
BBFILES += "${LAYERDIR}/recipes-*/*/*.bb \
            ${LAYERDIR}/recipes-*/*/*.bbappend"

BBFILE_COLLECTIONS += "meta-kerneldev"
BBFILE_PATTERN_meta-kerneldev = "^${LAYERDIR}/"
BBFILE_PRIORITY_meta-kerneldev = "6"

LAYERDEPENDS_meta-kerneldev = "core"
LAYERSERIES_COMPAT_meta-kerneldev = "kirkstone"
```
